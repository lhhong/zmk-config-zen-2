## config/west.yml
```yaml
manifest:
  remotes:
    - name: zmkfirmware
      url-base: https://github.com/lhhong
  projects:
    - name: zmk
      remote: zmkfirmware
      revision: zen2-mouse-power-layer
      import: app/west.yml
  self:
    path: config
```
